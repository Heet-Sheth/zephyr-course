## twister-out/qemu_cortex_m3_ti_lm3s6965/zephyr_gnu/zephyr-foundational/tests/ring_buf/homework.unit.ring_buf/Kconfig/soc/Kconfig
```kconfig
# Load Zephyr SoC Kconfig descriptions.
osource "/Users/heet/Zephyr/deps/zephyr/soc/xlnx/zynqmp/Kconfig"
osource "/Users/heet/Zephyr/deps/zephyr/soc/xlnx/zynq7000/Kconfig"
osource "/Users/heet/Zephyr/deps/zephyr/soc/xlnx/versalnet/Kconfig"
osource "/Users/heet/Zephyr/deps/zephyr/soc/xlnx/versal2/Kconfig"
osource "/Users/heet/Zephyr/deps/zephyr/soc/xlnx/versal/Kconfig"
osource "/Users/heet/Zephyr/deps/zephyr/soc/xen/Kconfig"
osource "/Users/heet/Zephyr/deps/zephyr/soc/wch/ch32v/Kconfig"
osource "/Users/heet/Zephyr/deps/zephyr/soc/ti/tiva_c/Kconfig"
osource "/Users/heet/Zephyr/deps/zephyr/soc/ti/simplelink/Kconfig"
osource "/Users/heet/Zephyr/deps/zephyr/soc/ti/mspm/Kconfig"
osource "/Users/heet/Zephyr/deps/zephyr/soc/ti/lm3s6965/Kconfig"
osource "/Users/heet/Zephyr/deps/zephyr/soc/ti/k3/Kconfig"
osource "/Users/heet/Zephyr/deps/zephyr/soc/ti/am13/Kconfig"
osource "/Users/heet/Zephyr/deps/zephyr/soc/telink/tlsr/Kconfig"
osource "/Users/heet/Zephyr/deps/zephyr/soc/syna/sr100/Kconfig"
osource "/Users/heet/Zephyr/deps/zephyr/soc/starfive/jh71xx/Kconfig"
osource "/Users/heet/Zephyr/deps/zephyr/soc/st/stm32/Kconfig"
osource "/Users/heet/Zephyr/deps/zephyr/soc/snps/qemu_arc/Kconfig"
osource "/Users/heet/Zephyr/deps/zephyr/soc/snps/nsim/arc_v/Kconfig"
osource "/Users/heet/Zephyr/deps/zephyr/soc/snps/nsim/arc_classic/Kconfig"
osource "/Users/heet/Zephyr/deps/zephyr/soc/snps/hsdk4xd/Kconfig"
osource "/Users/heet/Zephyr/deps/zephyr/soc/snps/hsdk/Kconfig"
osource "/Users/heet/Zephyr/deps/zephyr/soc/snps/emsk/Kconfig"
osource "/Users/heet/Zephyr/deps/zephyr/soc/snps/emsdp/Kconfig"
osource "/Users/heet/Zephyr/deps/zephyr/soc/snps/arc_iot/Kconfig"
osource "/Users/heet/Zephyr/deps/zephyr/soc/silabs/Kconfig"
osource "/Users/heet/Zephyr/deps/zephyr/soc/sifli/sf32/Kconfig"
osource "/Users/heet/Zephyr/deps/zephyr/soc/sifive/sifive_freedom/Kconfig"
osource "/Users/heet/Zephyr/deps/zephyr/soc/shakti/Kconfig"
osource "/Users/heet/Zephyr/deps/zephyr/soc/sensry/Kconfig"
osource "/Users/heet/Zephyr/deps/zephyr/soc/rockchip/Kconfig"
osource "/Users/heet/Zephyr/deps/zephyr/soc/renode/riscv_virtual/Kconfig"
osource "/Users/heet/Zephyr/deps/zephyr/soc/renode/cortex_r8_virtual/Kconfig"
osource "/Users/heet/Zephyr/deps/zephyr/soc/renesas/smartbond/Kconfig"
osource "/Users/heet/Zephyr/deps/zephyr/soc/renesas/rz/Kconfig"
osource "/Users/heet/Zephyr/deps/zephyr/soc/renesas/rx/Kconfig"
osource "/Users/heet/Zephyr/deps/zephyr/soc/renesas/rcar/Kconfig"
osource "/Users/heet/Zephyr/deps/zephyr/soc/renesas/ra/Kconfig"
osource "/Users/heet/Zephyr/deps/zephyr/soc/realtek/fingerprint/Kconfig"
osource "/Users/heet/Zephyr/deps/zephyr/soc/realtek/ec/Kconfig"
osource "/Users/heet/Zephyr/deps/zephyr/soc/realtek/bee/Kconfig"
osource "/Users/heet/Zephyr/deps/zephyr/soc/realtek/ameba/Kconfig"
osource "/Users/heet/Zephyr/deps/zephyr/soc/raspberrypi/rpi_pico/Kconfig"
osource "/Users/heet/Zephyr/deps/zephyr/soc/quicklogic/eos_s3/Kconfig"
osource "/Users/heet/Zephyr/deps/zephyr/soc/qemu/virt_riscv/Kconfig"
osource "/Users/heet/Zephyr/deps/zephyr/soc/qemu/tricore/Kconfig"
osource "/Users/heet/Zephyr/deps/zephyr/soc/qemu/or1k/Kconfig"
osource "/Users/heet/Zephyr/deps/zephyr/soc/qemu/malta/Kconfig"
osource "/Users/heet/Zephyr/deps/zephyr/soc/qemu/hexagon/Kconfig"
osource "/Users/heet/Zephyr/deps/zephyr/soc/openisa/rv32m1/Kconfig"
osource "/Users/heet/Zephyr/deps/zephyr/soc/openhwgroup/cva6/Kconfig"
osource "/Users/heet/Zephyr/deps/zephyr/soc/oct/osd32mp15x/Kconfig"
osource "/Users/heet/Zephyr/deps/zephyr/soc/nxp/s32/Kconfig"
osource "/Users/heet/Zephyr/deps/zephyr/soc/nxp/rw/Kconfig"
osource "/Users/heet/Zephyr/deps/zephyr/soc/nxp/mcx/Kconfig"
osource "/Users/heet/Zephyr/deps/zephyr/soc/nxp/lpc/Kconfig"
osource "/Users/heet/Zephyr/deps/zephyr/soc/nxp/layerscape/Kconfig"
osource "/Users/heet/Zephyr/deps/zephyr/soc/nxp/kinetis/Kconfig"
osource "/Users/heet/Zephyr/deps/zephyr/soc/nxp/imxrt/Kconfig"
osource "/Users/heet/Zephyr/deps/zephyr/soc/nxp/imx/Kconfig"
osource "/Users/heet/Zephyr/deps/zephyr/soc/nuvoton/numicro/Kconfig"
osource "/Users/heet/Zephyr/deps/zephyr/soc/nuvoton/numaker/Kconfig"
osource "/Users/heet/Zephyr/deps/zephyr/soc/nuvoton/npcx/Kconfig"
osource "/Users/heet/Zephyr/deps/zephyr/soc/nuvoton/npcm/Kconfig"
osource "/Users/heet/Zephyr/deps/zephyr/soc/nordic/Kconfig"
osource "/Users/heet/Zephyr/deps/zephyr/soc/neorv32/Kconfig"
osource "/Users/heet/Zephyr/deps/zephyr/soc/native/inf_clock/Kconfig"
osource "/Users/heet/Zephyr/deps/zephyr/soc/microchip/smartfusion2/Kconfig"
osource "/Users/heet/Zephyr/deps/zephyr/soc/microchip/sam/sama7/Kconfig"
osource "/Users/heet/Zephyr/deps/zephyr/soc/microchip/sam/sama5/Kconfig"
osource "/Users/heet/Zephyr/deps/zephyr/soc/microchip/sam/sam_d5x_e5x/Kconfig"
osource "/Users/heet/Zephyr/deps/zephyr/soc/microchip/pic64/Kconfig"
osource "/Users/heet/Zephyr/deps/zephyr/soc/microchip/pic32c/pic32cz_ca/Kconfig"
osource "/Users/heet/Zephyr/deps/zephyr/soc/microchip/pic32c/pic32cx_sg/Kconfig"
osource "/Users/heet/Zephyr/deps/zephyr/soc/microchip/pic32c/pic32cm_sg_gc/Kconfig"
osource "/Users/heet/Zephyr/deps/zephyr/soc/microchip/pic32c/pic32cm_pl/Kconfig"
osource "/Users/heet/Zephyr/deps/zephyr/soc/microchip/pic32c/pic32cm_jh/Kconfig"
osource "/Users/heet/Zephyr/deps/zephyr/soc/microchip/pic32c/pic32ck_sg_gc/Kconfig"
osource "/Users/heet/Zephyr/deps/zephyr/soc/microchip/miv/Kconfig"
osource "/Users/heet/Zephyr/deps/zephyr/soc/microchip/mec/Kconfig"
osource "/Users/heet/Zephyr/deps/zephyr/soc/mediatek/mt8xxx/Kconfig"
osource "/Users/heet/Zephyr/deps/zephyr/soc/lowrisc/opentitan/Kconfig"
osource "/Users/heet/Zephyr/deps/zephyr/soc/litex/Kconfig"
osource "/Users/heet/Zephyr/deps/zephyr/soc/ite/ec/Kconfig"
osource "/Users/heet/Zephyr/deps/zephyr/soc/intel/wildcat_lake/Kconfig"
osource "/Users/heet/Zephyr/deps/zephyr/soc/intel/raptor_lake/Kconfig"
osource "/Users/heet/Zephyr/deps/zephyr/soc/intel/panther_lake/Kconfig"
osource "/Users/heet/Zephyr/deps/zephyr/soc/intel/nova_lake/Kconfig"
osource "/Users/heet/Zephyr/deps/zephyr/soc/intel/lakemont/Kconfig"
osource "/Users/heet/Zephyr/deps/zephyr/soc/intel/intel_socfpga_std/Kconfig"
osource "/Users/heet/Zephyr/deps/zephyr/soc/intel/intel_socfpga/Kconfig"
osource "/Users/heet/Zephyr/deps/zephyr/soc/intel/intel_niosv/Kconfig"
osource "/Users/heet/Zephyr/deps/zephyr/soc/intel/intel_ish/Kconfig"
osource "/Users/heet/Zephyr/deps/zephyr/soc/intel/intel_adsp/Kconfig"
osource "/Users/heet/Zephyr/deps/zephyr/soc/intel/elkhart_lake/Kconfig"
osource "/Users/heet/Zephyr/deps/zephyr/soc/intel/atom/Kconfig"
osource "/Users/heet/Zephyr/deps/zephyr/soc/intel/apollo_lake/Kconfig"
osource "/Users/heet/Zephyr/deps/zephyr/soc/intel/alder_lake/Kconfig"
osource "/Users/heet/Zephyr/deps/zephyr/soc/infineon/psoc4/Kconfig"
osource "/Users/heet/Zephyr/deps/zephyr/soc/infineon/edge/Kconfig"
osource "/Users/heet/Zephyr/deps/zephyr/soc/infineon/cat3/Kconfig"
osource "/Users/heet/Zephyr/deps/zephyr/soc/infineon/cat1c/Kconfig"
osource "/Users/heet/Zephyr/deps/zephyr/soc/infineon/cat1b/Kconfig"
osource "/Users/heet/Zephyr/deps/zephyr/soc/infineon/cat1a/Kconfig"
osource "/Users/heet/Zephyr/deps/zephyr/soc/gd/gd32/Kconfig"
osource "/Users/heet/Zephyr/deps/zephyr/soc/gaisler/leon3/Kconfig"
osource "/Users/heet/Zephyr/deps/zephyr/soc/gaisler/gr716a/Kconfig"
osource "/Users/heet/Zephyr/deps/zephyr/soc/focaltech/Kconfig"
osource "/Users/heet/Zephyr/deps/zephyr/soc/espressif/Kconfig"
osource "/Users/heet/Zephyr/deps/zephyr/soc/ene/kb1200/Kconfig"
osource "/Users/heet/Zephyr/deps/zephyr/soc/ene/kb106x/Kconfig"
osource "/Users/heet/Zephyr/deps/zephyr/soc/elan/em32f967/Kconfig"
osource "/Users/heet/Zephyr/deps/zephyr/soc/egis/Kconfig"
osource "/Users/heet/Zephyr/deps/zephyr/soc/efinix/sapphire/Kconfig"
osource "/Users/heet/Zephyr/deps/zephyr/soc/cdns/xtensa_sample_controller/Kconfig"
osource "/Users/heet/Zephyr/deps/zephyr/soc/cdns/swerv/Kconfig"
osource "/Users/heet/Zephyr/deps/zephyr/soc/cdns/sample_controller32/Kconfig"
osource "/Users/heet/Zephyr/deps/zephyr/soc/cdns/dc233c/Kconfig"
osource "/Users/heet/Zephyr/deps/zephyr/soc/cdac/Kconfig"
osource "/Users/heet/Zephyr/deps/zephyr/soc/brcm/bcmvk/Kconfig"
osource "/Users/heet/Zephyr/deps/zephyr/soc/brcm/bcm2712/Kconfig"
osource "/Users/heet/Zephyr/deps/zephyr/soc/brcm/bcm2711/Kconfig"
osource "/Users/heet/Zephyr/deps/zephyr/soc/brcm/bcm2710/Kconfig"
osource "/Users/heet/Zephyr/deps/zephyr/soc/blackberry/qnxhv_vm/Kconfig"
osource "/Users/heet/Zephyr/deps/zephyr/soc/bflb/Kconfig"
osource "/Users/heet/Zephyr/deps/zephyr/soc/atmel/sam0/Kconfig"
osource "/Users/heet/Zephyr/deps/zephyr/soc/atmel/sam/Kconfig"
osource "/Users/heet/Zephyr/deps/zephyr/soc/aspeed/Kconfig"
osource "/Users/heet/Zephyr/deps/zephyr/soc/arm/Kconfig"
osource "/Users/heet/Zephyr/deps/zephyr/soc/antmicro/myra/Kconfig"
osource "/Users/heet/Zephyr/deps/zephyr/soc/andestech/Kconfig"
osource "/Users/heet/Zephyr/deps/zephyr/soc/amd/acp_7_x/Kconfig"
osource "/Users/heet/Zephyr/deps/zephyr/soc/amd/acp_7_0/Kconfig"
osource "/Users/heet/Zephyr/deps/zephyr/soc/amd/acp_6_0/Kconfig"
osource "/Users/heet/Zephyr/deps/zephyr/soc/ambiq/Kconfig"
osource "/Users/heet/Zephyr/deps/zephyr/soc/allwinner/sun8i_h3/Kconfig"
osource "/Users/heet/Zephyr/deps/zephyr/soc/allwinner/sun50i_h618/Kconfig"
osource "/Users/heet/Zephyr/deps/zephyr/soc/alif/ensemble/Kconfig"
osource "/Users/heet/Zephyr/deps/zephyr/soc/alif/balletto/Kconfig"
osource "/Users/heet/Zephyr/deps/zephyr/soc/aesc/Kconfig"
osource "/Users/heet/Zephyr/deps/zephyr/soc/adi/max32/Kconfig"
```

## twister-out/qemu_x86_atom/zephyr_gnu/zephyr-foundational/tests/ring_buf/homework.unit.ring_buf/Kconfig/boards/Kconfig.defconfig
```kconfig
# Load Zephyr board defconfig descriptions.
osource "/Users/heet/Zephyr/deps/zephyr/boards/qemu/x86/Kconfig.defconfig"
```

## twister-out/qemu_x86_atom/zephyr_gnu/zephyr-foundational/tests/ring_buf/homework.unit.ring_buf/Kconfig/boards/Kconfig.qemu_x86
```kconfig
# Load board Kconfig descriptions.
osource "/Users/heet/Zephyr/deps/zephyr/boards/qemu/x86/Kconfig.qemu_x86"
```

## twister-out/qemu_x86_atom/zephyr_gnu/zephyr-foundational/tests/ring_buf/homework.unit.ring_buf/Kconfig/boards/Kconfig.sysbuild
```kconfig
# Load Sysbuild board Kconfig descriptions.
osource "/Users/heet/Zephyr/deps/zephyr/boards/qemu/x86/Kconfig.sysbuild"
```
