## app/drivers/my_driver_module/drivers/sensor/led_sensor/Kconfig
```kconfig
config LED_SENSOR
    bool "LED Mock Sensor Driver"
    default y
    select SENSOR
    select GPIO
    help
      Enable driver for the LED-based mock sensor.
```

## app_archieved_till_lecture_7/boards/my_board/board.yml
```yaml
board:
  name: my_board
  full_name: MYb BOARD
  vendor: DarkPro
  socs:
  - name: mcxn236
```

## app_archieved_till_lecture_7/boards/our_board/board.yml
```yaml
board:
  name: our_board
  full_name: OUR BOARD
  vendor: DarkPro
  socs:
  - name: esp32s3
```

## tests/ring_buf/testcase.yaml
```yaml
common:
  tags:
    - unit
    - ring_buf
    - ztest
    - homework

tests:
  homework.unit.ring_buf:
    platform_allow: 
      - qemu_cortex_m3
      - qemu_x86
    timeout: 60
```

## twister-out.1/qemu_cortex_m3_ti_lm3s6965/zephyr_gnu/zephyr-foundational/tests/ring_buf/homework.unit.ring_buf/Kconfig/Kconfig.modules
```kconfig
menu "cmsis_6 (/Users/heet/Zephyr/deps/modules/hal/cmsis_6)"
osource "$(ZEPHYR_CMSIS_6_KCONFIG)"
config ZEPHYR_CMSIS_6_MODULE
	bool
	default y
endmenu
menu "hal_espressif (/Users/heet/Zephyr/deps/modules/hal/espressif)"
osource "/Users/heet/Zephyr/deps/modules/hal/espressif/zephyr/Kconfig"
config ZEPHYR_HAL_ESPRESSIF_MODULE
	bool
	default y

config ZEPHYR_HAL_ESPRESSIF_MODULE_BLOBS
	bool
endmenu
menu "hal_nxp (/Users/heet/Zephyr/deps/modules/hal/nxp)"
osource "$(ZEPHYR_HAL_NXP_KCONFIG)"
config ZEPHYR_HAL_NXP_MODULE
	bool
	default y

config ZEPHYR_HAL_NXP_MODULE_BLOBS
	bool
endmenu
```

## twister-out.1/qemu_cortex_m3_ti_lm3s6965/zephyr_gnu/zephyr-foundational/tests/ring_buf/homework.unit.ring_buf/Kconfig/boards/Kconfig.defconfig
```kconfig
# Load Zephyr board defconfig descriptions.
osource "/Users/heet/Zephyr/deps/zephyr/boards/qemu/cortex_m3/Kconfig.defconfig"
```

## twister-out.1/qemu_cortex_m3_ti_lm3s6965/zephyr_gnu/zephyr-foundational/tests/ring_buf/homework.unit.ring_buf/Kconfig/boards/Kconfig.qemu_cortex_m3
```kconfig
# Load board Kconfig descriptions.
osource "/Users/heet/Zephyr/deps/zephyr/boards/qemu/cortex_m3/Kconfig.qemu_cortex_m3"
```

## twister-out.1/qemu_cortex_m3_ti_lm3s6965/zephyr_gnu/zephyr-foundational/tests/ring_buf/homework.unit.ring_buf/Kconfig/boards/Kconfig.sysbuild
```kconfig
# Load Sysbuild board Kconfig descriptions.
osource "/Users/heet/Zephyr/deps/zephyr/boards/qemu/cortex_m3/Kconfig.sysbuild"
```

## twister-out.1/qemu_cortex_m3_ti_lm3s6965/zephyr_gnu/zephyr-foundational/tests/ring_buf/homework.unit.ring_buf/Kconfig/soc/Kconfig.soc
```kconfig
# Load SoC Kconfig descriptions.
osource "/Users/heet/Zephyr/deps/zephyr/soc/xlnx/zynqmp/Kconfig.soc"
osource "/Users/heet/Zephyr/deps/zephyr/soc/xlnx/zynq7000/Kconfig.soc"
osource "/Users/heet/Zephyr/deps/zephyr/soc/xlnx/versalnet/Kconfig.soc"
osource "/Users/heet/Zephyr/deps/zephyr/soc/xlnx/versal2/Kconfig.soc"
osource "/Users/heet/Zephyr/deps/zephyr/soc/xlnx/versal/Kconfig.soc"
osource "/Users/heet/Zephyr/deps/zephyr/soc/xen/Kconfig.soc"
osource "/Users/heet/Zephyr/deps/zephyr/soc/wch/ch32v/Kconfig.soc"
osource "/Users/heet/Zephyr/deps/zephyr/soc/ti/tiva_c/Kconfig.soc"
osource "/Users/heet/Zephyr/deps/zephyr/soc/ti/simplelink/Kconfig.soc"
osource "/Users/heet/Zephyr/deps/zephyr/soc/ti/mspm/Kconfig.soc"
osource "/Users/heet/Zephyr/deps/zephyr/soc/ti/lm3s6965/Kconfig.soc"
osource "/Users/heet/Zephyr/deps/zephyr/soc/ti/k3/Kconfig.soc"
osource "/Users/heet/Zephyr/deps/zephyr/soc/ti/am13/Kconfig.soc"
osource "/Users/heet/Zephyr/deps/zephyr/soc/telink/tlsr/Kconfig.soc"
osource "/Users/heet/Zephyr/deps/zephyr/soc/syna/sr100/Kconfig.soc"
osource "/Users/heet/Zephyr/deps/zephyr/soc/starfive/jh71xx/Kconfig.soc"
osource "/Users/heet/Zephyr/deps/zephyr/soc/st/stm32/Kconfig.soc"
osource "/Users/heet/Zephyr/deps/zephyr/soc/snps/qemu_arc/Kconfig.soc"
osource "/Users/heet/Zephyr/deps/zephyr/soc/snps/nsim/arc_v/Kconfig.soc"
osource "/Users/heet/Zephyr/deps/zephyr/soc/snps/nsim/arc_classic/Kconfig.soc"
osource "/Users/heet/Zephyr/deps/zephyr/soc/snps/hsdk4xd/Kconfig.soc"
osource "/Users/heet/Zephyr/deps/zephyr/soc/snps/hsdk/Kconfig.soc"
osource "/Users/heet/Zephyr/deps/zephyr/soc/snps/emsk/Kconfig.soc"
osource "/Users/heet/Zephyr/deps/zephyr/soc/snps/emsdp/Kconfig.soc"
osource "/Users/heet/Zephyr/deps/zephyr/soc/snps/arc_iot/Kconfig.soc"
osource "/Users/heet/Zephyr/deps/zephyr/soc/silabs/Kconfig.soc"
osource "/Users/heet/Zephyr/deps/zephyr/soc/sifli/sf32/Kconfig.soc"
osource "/Users/heet/Zephyr/deps/zephyr/soc/sifive/sifive_freedom/Kconfig.soc"
osource "/Users/heet/Zephyr/deps/zephyr/soc/shakti/Kconfig.soc"
osource "/Users/heet/Zephyr/deps/zephyr/soc/sensry/Kconfig.soc"
osource "/Users/heet/Zephyr/deps/zephyr/soc/rockchip/Kconfig.soc"
osource "/Users/heet/Zephyr/deps/zephyr/soc/renode/riscv_virtual/Kconfig.soc"
osource "/Users/heet/Zephyr/deps/zephyr/soc/renode/cortex_r8_virtual/Kconfig.soc"
osource "/Users/heet/Zephyr/deps/zephyr/soc/renesas/smartbond/Kconfig.soc"
osource "/Users/heet/Zephyr/deps/zephyr/soc/renesas/rz/Kconfig.soc"
osource "/Users/heet/Zephyr/deps/zephyr/soc/renesas/rx/Kconfig.soc"
osource "/Users/heet/Zephyr/deps/zephyr/soc/renesas/rcar/Kconfig.soc"
osource "/Users/heet/Zephyr/deps/zephyr/soc/renesas/ra/Kconfig.soc"
osource "/Users/heet/Zephyr/deps/zephyr/soc/realtek/fingerprint/Kconfig.soc"
osource "/Users/heet/Zephyr/deps/zephyr/soc/realtek/ec/Kconfig.soc"
osource "/Users/heet/Zephyr/deps/zephyr/soc/realtek/bee/Kconfig.soc"
osource "/Users/heet/Zephyr/deps/zephyr/soc/realtek/ameba/Kconfig.soc"
osource "/Users/heet/Zephyr/deps/zephyr/soc/raspberrypi/rpi_pico/Kconfig.soc"
osource "/Users/heet/Zephyr/deps/zephyr/soc/quicklogic/eos_s3/Kconfig.soc"
osource "/Users/heet/Zephyr/deps/zephyr/soc/qemu/virt_riscv/Kconfig.soc"
osource "/Users/heet/Zephyr/deps/zephyr/soc/qemu/tricore/Kconfig.soc"
osource "/Users/heet/Zephyr/deps/zephyr/soc/qemu/or1k/Kconfig.soc"
osource "/Users/heet/Zephyr/deps/zephyr/soc/qemu/malta/Kconfig.soc"
osource "/Users/heet/Zephyr/deps/zephyr/soc/qemu/hexagon/Kconfig.soc"
osource "/Users/heet/Zephyr/deps/zephyr/soc/openisa/rv32m1/Kconfig.soc"
osource "/Users/heet/Zephyr/deps/zephyr/soc/openhwgroup/cva6/Kconfig.soc"
osource "/Users/heet/Zephyr/deps/zephyr/soc/oct/osd32mp15x/Kconfig.soc"
osource "/Users/heet/Zephyr/deps/zephyr/soc/nxp/s32/Kconfig.soc"
osource "/Users/heet/Zephyr/deps/zephyr/soc/nxp/rw/Kconfig.soc"
osource "/Users/heet/Zephyr/deps/zephyr/soc/nxp/mcx/Kconfig.soc"
osource "/Users/heet/Zephyr/deps/zephyr/soc/nxp/lpc/Kconfig.soc"
osource "/Users/heet/Zephyr/deps/zephyr/soc/nxp/layerscape/Kconfig.soc"
osource "/Users/heet/Zephyr/deps/zephyr/soc/nxp/kinetis/Kconfig.soc"
osource "/Users/heet/Zephyr/deps/zephyr/soc/nxp/imxrt/Kconfig.soc"
osource "/Users/heet/Zephyr/deps/zephyr/soc/nxp/imx/Kconfig.soc"
osource "/Users/heet/Zephyr/deps/zephyr/soc/nuvoton/numicro/Kconfig.soc"
osource "/Users/heet/Zephyr/deps/zephyr/soc/nuvoton/numaker/Kconfig.soc"
osource "/Users/heet/Zephyr/deps/zephyr/soc/nuvoton/npcx/Kconfig.soc"
osource "/Users/heet/Zephyr/deps/zephyr/soc/nuvoton/npcm/Kconfig.soc"
osource "/Users/heet/Zephyr/deps/zephyr/soc/nordic/Kconfig.soc"
osource "/Users/heet/Zephyr/deps/zephyr/soc/neorv32/Kconfig.soc"
osource "/Users/heet/Zephyr/deps/zephyr/soc/native/inf_clock/Kconfig.soc"
osource "/Users/heet/Zephyr/deps/zephyr/soc/microchip/smartfusion2/Kconfig.soc"
osource "/Users/heet/Zephyr/deps/zephyr/soc/microchip/sam/sama7/Kconfig.soc"
osource "/Users/heet/Zephyr/deps/zephyr/soc/microchip/sam/sama5/Kconfig.soc"
osource "/Users/heet/Zephyr/deps/zephyr/soc/microchip/sam/sam_d5x_e5x/Kconfig.soc"
osource "/Users/heet/Zephyr/deps/zephyr/soc/microchip/pic64/Kconfig.soc"
osource "/Users/heet/Zephyr/deps/zephyr/soc/microchip/pic32c/pic32cz_ca/Kconfig.soc"
osource "/Users/heet/Zephyr/deps/zephyr/soc/microchip/pic32c/pic32cx_sg/Kconfig.soc"
osource "/Users/heet/Zephyr/deps/zephyr/soc/microchip/pic32c/pic32cm_sg_gc/Kconfig.soc"
osource "/Users/heet/Zephyr/deps/zephyr/soc/microchip/pic32c/pic32cm_pl/Kconfig.soc"
osource "/Users/heet/Zephyr/deps/zephyr/soc/microchip/pic32c/pic32cm_jh/Kconfig.soc"
osource "/Users/heet/Zephyr/deps/zephyr/soc/microchip/pic32c/pic32ck_sg_gc/Kconfig.soc"
osource "/Users/heet/Zephyr/deps/zephyr/soc/microchip/miv/Kconfig.soc"
osource "/Users/heet/Zephyr/deps/zephyr/soc/microchip/mec/Kconfig.soc"
osource "/Users/heet/Zephyr/deps/zephyr/soc/mediatek/mt8xxx/Kconfig.soc"
osource "/Users/heet/Zephyr/deps/zephyr/soc/lowrisc/opentitan/Kconfig.soc"
osource "/Users/heet/Zephyr/deps/zephyr/soc/litex/Kconfig.soc"
osource "/Users/heet/Zephyr/deps/zephyr/soc/ite/ec/Kconfig.soc"
osource "/Users/heet/Zephyr/deps/zephyr/soc/intel/wildcat_lake/Kconfig.soc"
osource "/Users/heet/Zephyr/deps/zephyr/soc/intel/raptor_lake/Kconfig.soc"
osource "/Users/heet/Zephyr/deps/zephyr/soc/intel/panther_lake/Kconfig.soc"
osource "/Users/heet/Zephyr/deps/zephyr/soc/intel/nova_lake/Kconfig.soc"
osource "/Users/heet/Zephyr/deps/zephyr/soc/intel/lakemont/Kconfig.soc"
osource "/Users/heet/Zephyr/deps/zephyr/soc/intel/intel_socfpga_std/Kconfig.soc"
osource "/Users/heet/Zephyr/deps/zephyr/soc/intel/intel_socfpga/Kconfig.soc"
osource "/Users/heet/Zephyr/deps/zephyr/soc/intel/intel_niosv/Kconfig.soc"
osource "/Users/heet/Zephyr/deps/zephyr/soc/intel/intel_ish/Kconfig.soc"
osource "/Users/heet/Zephyr/deps/zephyr/soc/intel/intel_adsp/Kconfig.soc"
osource "/Users/heet/Zephyr/deps/zephyr/soc/intel/elkhart_lake/Kconfig.soc"
osource "/Users/heet/Zephyr/deps/zephyr/soc/intel/atom/Kconfig.soc"
osource "/Users/heet/Zephyr/deps/zephyr/soc/intel/apollo_lake/Kconfig.soc"
osource "/Users/heet/Zephyr/deps/zephyr/soc/intel/alder_lake/Kconfig.soc"
osource "/Users/heet/Zephyr/deps/zephyr/soc/infineon/psoc4/Kconfig.soc"
osource "/Users/heet/Zephyr/deps/zephyr/soc/infineon/edge/Kconfig.soc"
osource "/Users/heet/Zephyr/deps/zephyr/soc/infineon/cat3/Kconfig.soc"
osource "/Users/heet/Zephyr/deps/zephyr/soc/infineon/cat1c/Kconfig.soc"
osource "/Users/heet/Zephyr/deps/zephyr/soc/infineon/cat1b/Kconfig.soc"
osource "/Users/heet/Zephyr/deps/zephyr/soc/infineon/cat1a/Kconfig.soc"
osource "/Users/heet/Zephyr/deps/zephyr/soc/gd/gd32/Kconfig.soc"
osource "/Users/heet/Zephyr/deps/zephyr/soc/gaisler/leon3/Kconfig.soc"
osource "/Users/heet/Zephyr/deps/zephyr/soc/gaisler/gr716a/Kconfig.soc"
osource "/Users/heet/Zephyr/deps/zephyr/soc/focaltech/Kconfig.soc"
osource "/Users/heet/Zephyr/deps/zephyr/soc/espressif/Kconfig.soc"
osource "/Users/heet/Zephyr/deps/zephyr/soc/ene/kb1200/Kconfig.soc"
osource "/Users/heet/Zephyr/deps/zephyr/soc/ene/kb106x/Kconfig.soc"
osource "/Users/heet/Zephyr/deps/zephyr/soc/elan/em32f967/Kconfig.soc"
osource "/Users/heet/Zephyr/deps/zephyr/soc/egis/Kconfig.soc"
osource "/Users/heet/Zephyr/deps/zephyr/soc/efinix/sapphire/Kconfig.soc"
osource "/Users/heet/Zephyr/deps/zephyr/soc/cdns/xtensa_sample_controller/Kconfig.soc"
osource "/Users/heet/Zephyr/deps/zephyr/soc/cdns/swerv/Kconfig.soc"
osource "/Users/heet/Zephyr/deps/zephyr/soc/cdns/sample_controller32/Kconfig.soc"
osource "/Users/heet/Zephyr/deps/zephyr/soc/cdns/dc233c/Kconfig.soc"
osource "/Users/heet/Zephyr/deps/zephyr/soc/cdac/Kconfig.soc"
osource "/Users/heet/Zephyr/deps/zephyr/soc/brcm/bcmvk/Kconfig.soc"
osource "/Users/heet/Zephyr/deps/zephyr/soc/brcm/bcm2712/Kconfig.soc"
osource "/Users/heet/Zephyr/deps/zephyr/soc/brcm/bcm2711/Kconfig.soc"
osource "/Users/heet/Zephyr/deps/zephyr/soc/brcm/bcm2710/Kconfig.soc"
osource "/Users/heet/Zephyr/deps/zephyr/soc/blackberry/qnxhv_vm/Kconfig.soc"
osource "/Users/heet/Zephyr/deps/zephyr/soc/bflb/Kconfig.soc"
osource "/Users/heet/Zephyr/deps/zephyr/soc/atmel/sam0/Kconfig.soc"
osource "/Users/heet/Zephyr/deps/zephyr/soc/atmel/sam/Kconfig.soc"
osource "/Users/heet/Zephyr/deps/zephyr/soc/aspeed/Kconfig.soc"
osource "/Users/heet/Zephyr/deps/zephyr/soc/arm/Kconfig.soc"
osource "/Users/heet/Zephyr/deps/zephyr/soc/antmicro/myra/Kconfig.soc"
osource "/Users/heet/Zephyr/deps/zephyr/soc/andestech/Kconfig.soc"
osource "/Users/heet/Zephyr/deps/zephyr/soc/amd/acp_7_x/Kconfig.soc"
osource "/Users/heet/Zephyr/deps/zephyr/soc/amd/acp_7_0/Kconfig.soc"
osource "/Users/heet/Zephyr/deps/zephyr/soc/amd/acp_6_0/Kconfig.soc"
osource "/Users/heet/Zephyr/deps/zephyr/soc/ambiq/Kconfig.soc"
osource "/Users/heet/Zephyr/deps/zephyr/soc/allwinner/sun8i_h3/Kconfig.soc"
osource "/Users/heet/Zephyr/deps/zephyr/soc/allwinner/sun50i_h618/Kconfig.soc"
osource "/Users/heet/Zephyr/deps/zephyr/soc/alif/ensemble/Kconfig.soc"
osource "/Users/heet/Zephyr/deps/zephyr/soc/alif/balletto/Kconfig.soc"
osource "/Users/heet/Zephyr/deps/zephyr/soc/aesc/Kconfig.soc"
osource "/Users/heet/Zephyr/deps/zephyr/soc/adi/max32/Kconfig.soc"
```

## twister-out/qemu_cortex_m3_ti_lm3s6965/zephyr_gnu/zephyr-foundational/tests/ring_buf/homework.unit.ring_buf/Kconfig/arch/Kconfig
```kconfig
# Load Zephyr Arch Kconfig descriptions.
osource "/Users/heet/Zephyr/deps/zephyr/arch/tricore/Kconfig"
osource "/Users/heet/Zephyr/deps/zephyr/arch/hexagon/Kconfig"
osource "/Users/heet/Zephyr/deps/zephyr/arch/rx/Kconfig"
osource "/Users/heet/Zephyr/deps/zephyr/arch/x86/Kconfig"
osource "/Users/heet/Zephyr/deps/zephyr/arch/xtensa/Kconfig"
osource "/Users/heet/Zephyr/deps/zephyr/arch/sparc/Kconfig"
osource "/Users/heet/Zephyr/deps/zephyr/arch/riscv/Kconfig"
osource "/Users/heet/Zephyr/deps/zephyr/arch/posix/Kconfig"
osource "/Users/heet/Zephyr/deps/zephyr/arch/openrisc/Kconfig"
osource "/Users/heet/Zephyr/deps/zephyr/arch/mips/Kconfig"
osource "/Users/heet/Zephyr/deps/zephyr/arch/arm64/Kconfig"
osource "/Users/heet/Zephyr/deps/zephyr/arch/arm/Kconfig"
osource "/Users/heet/Zephyr/deps/zephyr/arch/arc/Kconfig"
```
