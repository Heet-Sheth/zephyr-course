## twister-out/qemu_x86_atom/zephyr_gnu/zephyr-foundational/tests/ring_buf/homework.unit.ring_buf/Kconfig/soc/Kconfig.sysbuild
```kconfig
# Load Sysbuild SoC Kconfig descriptions.
osource "/Users/heet/Zephyr/deps/zephyr/soc/xlnx/zynqmp/Kconfig.sysbuild"
osource "/Users/heet/Zephyr/deps/zephyr/soc/xlnx/zynq7000/Kconfig.sysbuild"
osource "/Users/heet/Zephyr/deps/zephyr/soc/xlnx/versalnet/Kconfig.sysbuild"
osource "/Users/heet/Zephyr/deps/zephyr/soc/xlnx/versal2/Kconfig.sysbuild"
osource "/Users/heet/Zephyr/deps/zephyr/soc/xlnx/versal/Kconfig.sysbuild"
osource "/Users/heet/Zephyr/deps/zephyr/soc/xen/Kconfig.sysbuild"
osource "/Users/heet/Zephyr/deps/zephyr/soc/wch/ch32v/Kconfig.sysbuild"
osource "/Users/heet/Zephyr/deps/zephyr/soc/ti/tiva_c/Kconfig.sysbuild"
osource "/Users/heet/Zephyr/deps/zephyr/soc/ti/simplelink/Kconfig.sysbuild"
osource "/Users/heet/Zephyr/deps/zephyr/soc/ti/mspm/Kconfig.sysbuild"
osource "/Users/heet/Zephyr/deps/zephyr/soc/ti/lm3s6965/Kconfig.sysbuild"
osource "/Users/heet/Zephyr/deps/zephyr/soc/ti/k3/Kconfig.sysbuild"
osource "/Users/heet/Zephyr/deps/zephyr/soc/ti/am13/Kconfig.sysbuild"
osource "/Users/heet/Zephyr/deps/zephyr/soc/telink/tlsr/Kconfig.sysbuild"
osource "/Users/heet/Zephyr/deps/zephyr/soc/syna/sr100/Kconfig.sysbuild"
osource "/Users/heet/Zephyr/deps/zephyr/soc/starfive/jh71xx/Kconfig.sysbuild"
osource "/Users/heet/Zephyr/deps/zephyr/soc/st/stm32/Kconfig.sysbuild"
osource "/Users/heet/Zephyr/deps/zephyr/soc/snps/qemu_arc/Kconfig.sysbuild"
osource "/Users/heet/Zephyr/deps/zephyr/soc/snps/nsim/arc_v/Kconfig.sysbuild"
osource "/Users/heet/Zephyr/deps/zephyr/soc/snps/nsim/arc_classic/Kconfig.sysbuild"
osource "/Users/heet/Zephyr/deps/zephyr/soc/snps/hsdk4xd/Kconfig.sysbuild"
osource "/Users/heet/Zephyr/deps/zephyr/soc/snps/hsdk/Kconfig.sysbuild"
osource "/Users/heet/Zephyr/deps/zephyr/soc/snps/emsk/Kconfig.sysbuild"
osource "/Users/heet/Zephyr/deps/zephyr/soc/snps/emsdp/Kconfig.sysbuild"
osource "/Users/heet/Zephyr/deps/zephyr/soc/snps/arc_iot/Kconfig.sysbuild"
osource "/Users/heet/Zephyr/deps/zephyr/soc/silabs/Kconfig.sysbuild"
osource "/Users/heet/Zephyr/deps/zephyr/soc/sifli/sf32/Kconfig.sysbuild"
osource "/Users/heet/Zephyr/deps/zephyr/soc/sifive/sifive_freedom/Kconfig.sysbuild"
osource "/Users/heet/Zephyr/deps/zephyr/soc/shakti/Kconfig.sysbuild"
osource "/Users/heet/Zephyr/deps/zephyr/soc/sensry/Kconfig.sysbuild"
osource "/Users/heet/Zephyr/deps/zephyr/soc/rockchip/Kconfig.sysbuild"
osource "/Users/heet/Zephyr/deps/zephyr/soc/renode/riscv_virtual/Kconfig.sysbuild"
osource "/Users/heet/Zephyr/deps/zephyr/soc/renode/cortex_r8_virtual/Kconfig.sysbuild"
osource "/Users/heet/Zephyr/deps/zephyr/soc/renesas/smartbond/Kconfig.sysbuild"
osource "/Users/heet/Zephyr/deps/zephyr/soc/renesas/rz/Kconfig.sysbuild"
osource "/Users/heet/Zephyr/deps/zephyr/soc/renesas/rx/Kconfig.sysbuild"
osource "/Users/heet/Zephyr/deps/zephyr/soc/renesas/rcar/Kconfig.sysbuild"
osource "/Users/heet/Zephyr/deps/zephyr/soc/renesas/ra/Kconfig.sysbuild"
osource "/Users/heet/Zephyr/deps/zephyr/soc/realtek/fingerprint/Kconfig.sysbuild"
osource "/Users/heet/Zephyr/deps/zephyr/soc/realtek/ec/Kconfig.sysbuild"
osource "/Users/heet/Zephyr/deps/zephyr/soc/realtek/bee/Kconfig.sysbuild"
osource "/Users/heet/Zephyr/deps/zephyr/soc/realtek/ameba/Kconfig.sysbuild"
osource "/Users/heet/Zephyr/deps/zephyr/soc/raspberrypi/rpi_pico/Kconfig.sysbuild"
osource "/Users/heet/Zephyr/deps/zephyr/soc/quicklogic/eos_s3/Kconfig.sysbuild"
osource "/Users/heet/Zephyr/deps/zephyr/soc/qemu/virt_riscv/Kconfig.sysbuild"
osource "/Users/heet/Zephyr/deps/zephyr/soc/qemu/tricore/Kconfig.sysbuild"
osource "/Users/heet/Zephyr/deps/zephyr/soc/qemu/or1k/Kconfig.sysbuild"
osource "/Users/heet/Zephyr/deps/zephyr/soc/qemu/malta/Kconfig.sysbuild"
osource "/Users/heet/Zephyr/deps/zephyr/soc/qemu/hexagon/Kconfig.sysbuild"
osource "/Users/heet/Zephyr/deps/zephyr/soc/openisa/rv32m1/Kconfig.sysbuild"
osource "/Users/heet/Zephyr/deps/zephyr/soc/openhwgroup/cva6/Kconfig.sysbuild"
osource "/Users/heet/Zephyr/deps/zephyr/soc/oct/osd32mp15x/Kconfig.sysbuild"
osource "/Users/heet/Zephyr/deps/zephyr/soc/nxp/s32/Kconfig.sysbuild"
osource "/Users/heet/Zephyr/deps/zephyr/soc/nxp/rw/Kconfig.sysbuild"
osource "/Users/heet/Zephyr/deps/zephyr/soc/nxp/mcx/Kconfig.sysbuild"
osource "/Users/heet/Zephyr/deps/zephyr/soc/nxp/lpc/Kconfig.sysbuild"
osource "/Users/heet/Zephyr/deps/zephyr/soc/nxp/layerscape/Kconfig.sysbuild"
osource "/Users/heet/Zephyr/deps/zephyr/soc/nxp/kinetis/Kconfig.sysbuild"
osource "/Users/heet/Zephyr/deps/zephyr/soc/nxp/imxrt/Kconfig.sysbuild"
osource "/Users/heet/Zephyr/deps/zephyr/soc/nxp/imx/Kconfig.sysbuild"
osource "/Users/heet/Zephyr/deps/zephyr/soc/nuvoton/numicro/Kconfig.sysbuild"
osource "/Users/heet/Zephyr/deps/zephyr/soc/nuvoton/numaker/Kconfig.sysbuild"
osource "/Users/heet/Zephyr/deps/zephyr/soc/nuvoton/npcx/Kconfig.sysbuild"
osource "/Users/heet/Zephyr/deps/zephyr/soc/nuvoton/npcm/Kconfig.sysbuild"
osource "/Users/heet/Zephyr/deps/zephyr/soc/nordic/Kconfig.sysbuild"
osource "/Users/heet/Zephyr/deps/zephyr/soc/neorv32/Kconfig.sysbuild"
osource "/Users/heet/Zephyr/deps/zephyr/soc/native/inf_clock/Kconfig.sysbuild"
osource "/Users/heet/Zephyr/deps/zephyr/soc/microchip/smartfusion2/Kconfig.sysbuild"
osource "/Users/heet/Zephyr/deps/zephyr/soc/microchip/sam/sama7/Kconfig.sysbuild"
osource "/Users/heet/Zephyr/deps/zephyr/soc/microchip/sam/sama5/Kconfig.sysbuild"
osource "/Users/heet/Zephyr/deps/zephyr/soc/microchip/sam/sam_d5x_e5x/Kconfig.sysbuild"
osource "/Users/heet/Zephyr/deps/zephyr/soc/microchip/pic64/Kconfig.sysbuild"
osource "/Users/heet/Zephyr/deps/zephyr/soc/microchip/pic32c/pic32cz_ca/Kconfig.sysbuild"
osource "/Users/heet/Zephyr/deps/zephyr/soc/microchip/pic32c/pic32cx_sg/Kconfig.sysbuild"
osource "/Users/heet/Zephyr/deps/zephyr/soc/microchip/pic32c/pic32cm_sg_gc/Kconfig.sysbuild"
osource "/Users/heet/Zephyr/deps/zephyr/soc/microchip/pic32c/pic32cm_pl/Kconfig.sysbuild"
osource "/Users/heet/Zephyr/deps/zephyr/soc/microchip/pic32c/pic32cm_jh/Kconfig.sysbuild"
osource "/Users/heet/Zephyr/deps/zephyr/soc/microchip/pic32c/pic32ck_sg_gc/Kconfig.sysbuild"
osource "/Users/heet/Zephyr/deps/zephyr/soc/microchip/miv/Kconfig.sysbuild"
osource "/Users/heet/Zephyr/deps/zephyr/soc/microchip/mec/Kconfig.sysbuild"
osource "/Users/heet/Zephyr/deps/zephyr/soc/mediatek/mt8xxx/Kconfig.sysbuild"
osource "/Users/heet/Zephyr/deps/zephyr/soc/lowrisc/opentitan/Kconfig.sysbuild"
osource "/Users/heet/Zephyr/deps/zephyr/soc/litex/Kconfig.sysbuild"
osource "/Users/heet/Zephyr/deps/zephyr/soc/ite/ec/Kconfig.sysbuild"
osource "/Users/heet/Zephyr/deps/zephyr/soc/intel/wildcat_lake/Kconfig.sysbuild"
osource "/Users/heet/Zephyr/deps/zephyr/soc/intel/raptor_lake/Kconfig.sysbuild"
osource "/Users/heet/Zephyr/deps/zephyr/soc/intel/panther_lake/Kconfig.sysbuild"
osource "/Users/heet/Zephyr/deps/zephyr/soc/intel/nova_lake/Kconfig.sysbuild"
osource "/Users/heet/Zephyr/deps/zephyr/soc/intel/lakemont/Kconfig.sysbuild"
osource "/Users/heet/Zephyr/deps/zephyr/soc/intel/intel_socfpga_std/Kconfig.sysbuild"
osource "/Users/heet/Zephyr/deps/zephyr/soc/intel/intel_socfpga/Kconfig.sysbuild"
osource "/Users/heet/Zephyr/deps/zephyr/soc/intel/intel_niosv/Kconfig.sysbuild"
osource "/Users/heet/Zephyr/deps/zephyr/soc/intel/intel_ish/Kconfig.sysbuild"
osource "/Users/heet/Zephyr/deps/zephyr/soc/intel/intel_adsp/Kconfig.sysbuild"
osource "/Users/heet/Zephyr/deps/zephyr/soc/intel/elkhart_lake/Kconfig.sysbuild"
osource "/Users/heet/Zephyr/deps/zephyr/soc/intel/atom/Kconfig.sysbuild"
osource "/Users/heet/Zephyr/deps/zephyr/soc/intel/apollo_lake/Kconfig.sysbuild"
osource "/Users/heet/Zephyr/deps/zephyr/soc/intel/alder_lake/Kconfig.sysbuild"
osource "/Users/heet/Zephyr/deps/zephyr/soc/infineon/psoc4/Kconfig.sysbuild"
osource "/Users/heet/Zephyr/deps/zephyr/soc/infineon/edge/Kconfig.sysbuild"
osource "/Users/heet/Zephyr/deps/zephyr/soc/infineon/cat3/Kconfig.sysbuild"
osource "/Users/heet/Zephyr/deps/zephyr/soc/infineon/cat1c/Kconfig.sysbuild"
osource "/Users/heet/Zephyr/deps/zephyr/soc/infineon/cat1b/Kconfig.sysbuild"
osource "/Users/heet/Zephyr/deps/zephyr/soc/infineon/cat1a/Kconfig.sysbuild"
osource "/Users/heet/Zephyr/deps/zephyr/soc/gd/gd32/Kconfig.sysbuild"
osource "/Users/heet/Zephyr/deps/zephyr/soc/gaisler/leon3/Kconfig.sysbuild"
osource "/Users/heet/Zephyr/deps/zephyr/soc/gaisler/gr716a/Kconfig.sysbuild"
osource "/Users/heet/Zephyr/deps/zephyr/soc/focaltech/Kconfig.sysbuild"
osource "/Users/heet/Zephyr/deps/zephyr/soc/espressif/Kconfig.sysbuild"
osource "/Users/heet/Zephyr/deps/zephyr/soc/ene/kb1200/Kconfig.sysbuild"
osource "/Users/heet/Zephyr/deps/zephyr/soc/ene/kb106x/Kconfig.sysbuild"
osource "/Users/heet/Zephyr/deps/zephyr/soc/elan/em32f967/Kconfig.sysbuild"
osource "/Users/heet/Zephyr/deps/zephyr/soc/egis/Kconfig.sysbuild"
osource "/Users/heet/Zephyr/deps/zephyr/soc/efinix/sapphire/Kconfig.sysbuild"
osource "/Users/heet/Zephyr/deps/zephyr/soc/cdns/xtensa_sample_controller/Kconfig.sysbuild"
osource "/Users/heet/Zephyr/deps/zephyr/soc/cdns/swerv/Kconfig.sysbuild"
osource "/Users/heet/Zephyr/deps/zephyr/soc/cdns/sample_controller32/Kconfig.sysbuild"
osource "/Users/heet/Zephyr/deps/zephyr/soc/cdns/dc233c/Kconfig.sysbuild"
osource "/Users/heet/Zephyr/deps/zephyr/soc/cdac/Kconfig.sysbuild"
osource "/Users/heet/Zephyr/deps/zephyr/soc/brcm/bcmvk/Kconfig.sysbuild"
osource "/Users/heet/Zephyr/deps/zephyr/soc/brcm/bcm2712/Kconfig.sysbuild"
osource "/Users/heet/Zephyr/deps/zephyr/soc/brcm/bcm2711/Kconfig.sysbuild"
osource "/Users/heet/Zephyr/deps/zephyr/soc/brcm/bcm2710/Kconfig.sysbuild"
osource "/Users/heet/Zephyr/deps/zephyr/soc/blackberry/qnxhv_vm/Kconfig.sysbuild"
osource "/Users/heet/Zephyr/deps/zephyr/soc/bflb/Kconfig.sysbuild"
osource "/Users/heet/Zephyr/deps/zephyr/soc/atmel/sam0/Kconfig.sysbuild"
osource "/Users/heet/Zephyr/deps/zephyr/soc/atmel/sam/Kconfig.sysbuild"
osource "/Users/heet/Zephyr/deps/zephyr/soc/aspeed/Kconfig.sysbuild"
osource "/Users/heet/Zephyr/deps/zephyr/soc/arm/Kconfig.sysbuild"
osource "/Users/heet/Zephyr/deps/zephyr/soc/antmicro/myra/Kconfig.sysbuild"
osource "/Users/heet/Zephyr/deps/zephyr/soc/andestech/Kconfig.sysbuild"
osource "/Users/heet/Zephyr/deps/zephyr/soc/amd/acp_7_x/Kconfig.sysbuild"
osource "/Users/heet/Zephyr/deps/zephyr/soc/amd/acp_7_0/Kconfig.sysbuild"
osource "/Users/heet/Zephyr/deps/zephyr/soc/amd/acp_6_0/Kconfig.sysbuild"
osource "/Users/heet/Zephyr/deps/zephyr/soc/ambiq/Kconfig.sysbuild"
osource "/Users/heet/Zephyr/deps/zephyr/soc/allwinner/sun8i_h3/Kconfig.sysbuild"
osource "/Users/heet/Zephyr/deps/zephyr/soc/allwinner/sun50i_h618/Kconfig.sysbuild"
osource "/Users/heet/Zephyr/deps/zephyr/soc/alif/ensemble/Kconfig.sysbuild"
osource "/Users/heet/Zephyr/deps/zephyr/soc/alif/balletto/Kconfig.sysbuild"
osource "/Users/heet/Zephyr/deps/zephyr/soc/aesc/Kconfig.sysbuild"
osource "/Users/heet/Zephyr/deps/zephyr/soc/adi/max32/Kconfig.sysbuild"
```
